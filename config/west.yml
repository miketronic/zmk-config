## config/west.yml
```yaml
#
# Aeliux_v4
#

manifest:
  remotes:
    - name: zmkfirmware
      url-base: https://github.com/zmkfirmware
    - name: miketronic
      url-base: https://github.com/miketronic
    - name: caksoylar
      url-base: https://github.com/caksoylar
      
  projects:
    - name: zmk
      remote: zmkfirmware
      revision: v0.3
      import: app/west.yml
    - name: zmk-keyboards-aeliux_4
      remote: miketronic
      revision: main
    - name: zmk-rgbled-widget
      remote: caksoylar
      revision: v0.3
      
  self:
    path: config
```
