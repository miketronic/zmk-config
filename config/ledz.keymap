/*
 * Copyright (c) 2024 miketronic
 * SPDX-License-Identifier: MIT
 * LEDZ 
 */

#include <behaviors.dtsi>
#include <dt-bindings/zmk/keys.h>
#include <dt-bindings/zmk/outputs.h>
#include <dt-bindings/zmk/rgb.h>

#define RGB         0

#define RTOG     &rgb_ug RGB_TOG
#define RHI      &rgb_ug RGB_HUI
#define RSI      &rgb_ug RGB_SAI
#define RBI      &rgb_ug RGB_BRI

#define NNN   &none

&led_strip {
    chain-length = <21>;
};

/ {


    keymap {
        compatible = "zmk,keymap";

        rgb_layer {  
            bindings = <
                RTOG   NNN   NNN     RHI  RSI   RBI
            >;
        };

    };
};
